## conf/layer.conf
```bitbake
# We have a conf and classes directory, add to BBPATH
BBPATH =. "${LAYERDIR}:"

# We have recipes-* directories, add to BBFILES
BBFILES += "${LAYERDIR}/recipes-*/*/*.bb \
            ${LAYERDIR}/recipes-*/*/*.bbappend"

BBFILE_COLLECTIONS += "meta-sifive"
BBFILE_PATTERN_meta-sifive = "^${LAYERDIR}/"
BBFILE_PRIORITY_meta-sifive = "8"

# This should only be incremented on significant changes that will
# cause compatibility issues with other layers
LAYERVERSION_meta-sifive-layer = "1"

LAYERDEPENDS_meta-sifive = "core"
LAYERDEPENDS_meta-sifive += "riscv-layer"
LAYERDEPENDS_meta-sifive += "openembedded-layer"
LAYERDEPENDS_meta-sifive += "networking-layer"

LAYERSERIES_COMPAT_meta-sifive = "warrior zeus dunfell"
```

## conf/machine/freedom-u540.conf
```bitbake
#@TYPE: Machine
#@NAME: freedom-u540
#@SOC: Freedom U540
#@DESCRIPTION: Machine configuration for the HiFive Unleashed development board

DEFAULTTUNE ?= "riscv64"
require conf/machine/include/riscv/tune-sifive.inc

MACHINE_FEATURES = "screen keyboard ext2 ext3 serial"

KERNEL_IMAGETYPE = "Image.gz"

PREFERRED_PROVIDER_virtual/kernel ?= "linux-mainline"
PREFERRED_PROVIDER_virtual/bootloader ?= "u-boot"

EXTRA_IMAGEDEPENDS += "opensbi"
RISCV_SBI_PLAT = "generic"

RISCV_SBI_FDT ?= "hifive-unleashed-a00.dtb"

SERIAL_CONSOLES = "115200;ttySIF0"

MACHINE_EXTRA_RRECOMMENDS += " kernel-modules"

IMAGE_FSTYPES += "wic.xz ext4 tar.xz"
KERNEL_DEVICETREE ?= "sifive/${RISCV_SBI_FDT}"

## Do not update fstab file when using wic images
#WIC_CREATE_EXTRA_ARGS ?= "--no-fstab-update"

EXTRA_IMAGEDEPENDS += "u-boot"
UBOOT_MACHINE = "sifive_unleashed_defconfig"

## Set this to "mmc-boot" to generate a boot.scr file which should be included
##  in the boot partition. It will try to load a kernel image by TFTP and if that
##  fails it will fall back to local images in the boot partition.
UBOOT_ENV ?= "mmc-boot"

# U-Boot SPL
SPL_BINARY ?= "spl/u-boot-spl.bin"

# U-Boot ITB (FIT image with U-Boot S-mode, OpenSBI FW_DYNAMIC, DTB [from
# U-Boot source code tree])
UBOOT_SUFFIX ?= "itb"

## wic default support
WKS_FILE_DEPENDS ?= " \
    opensbi \
    e2fsprogs-native \
    bmap-tools-native \
"

IMAGE_BOOT_FILES ?= " \
    Image.gz \
    hifive-unleashed-a00.dtb \
    boot.scr.uimg \
"

WKS_FILE ?= "freedom-u540-spl-opensbi.wks"

BAD_RECOMMENDATIONS += "\
    libcxx-dev \
    libcxx-staticdev \
    compiler-rt-dev \
    compiler-rt-staticdev \
"
ASSUME_PROVIDED += "\
    libcxx-dev \
    libcxx-staticdev \
    compiler-rt-dev \
    compiler-rt-staticdev \
"
```

## conf/machine/qemuriscv64.conf
```bitbake
#@TYPE: Machine
#@NAME: generic riscv64 machine
#@DESCRIPTION: Machine configuration for running a generic riscv64

require conf/machine/include/riscv/qemuriscv.inc

XVISOR_PLAT = "riscv/virt64"

IMAGE_FSTYPES += "tar.xz"
IMAGE_FSTYPES:remove = "tar.bz2"

EXTRA_IMAGEDEPENDS += "u-boot"
UBOOT_MACHINE = "qemu-riscv64_smode_defconfig"
UBOOT_ELF = "u-boot"

PREFERRED_PROVIDER_virtual/kernel ?= "linux-mainline"
```

## conf/machine/qemuriscv64_b.conf
```bitbake
#@TYPE: Machine
#@NAME: generic riscv64 machine with B-ext
#@DESCRIPTION: Machine configuration for running a generic riscv64b

require conf/machine/include/riscv/qemuriscv.inc

XVISOR_PLAT = "riscv/virt64"

EXTRA_IMAGEDEPENDS += "u-boot"
UBOOT_MACHINE = "qemu-riscv64_smode_defconfig"
UBOOT_ELF = "u-boot"

# qemuboot options
QB_SYSTEM_NAME = "qemu-system-riscv64"
QB_CPU = "-cpu rv64,x-b=true"
QB_SMP = "-smp 4"

KMACHINE_qemuriscv64_b = "qemuriscv64"
```

## conf/machine/qemuriscv64_b_zfh.conf
```bitbake
#@TYPE: Machine
#@NAME: generic riscv64 machine with B and Zfh-ext
#@DESCRIPTION: Machine configuration for running a generic riscv64b and Zfh-ext

require conf/machine/include/riscv/qemuriscv.inc

XVISOR_PLAT = "riscv/virt64"

EXTRA_IMAGEDEPENDS += "u-boot"
UBOOT_MACHINE = "qemu-riscv64_smode_defconfig"
UBOOT_ELF = "u-boot"

# qemuboot options
QB_SYSTEM_NAME = "qemu-system-riscv64"
QB_CPU = "-cpu rv64,x-b=true,x-Zfh=true"
QB_SMP = "-smp 4"

PREFERRED_PROVIDER_virtual/kernel ?= "linux-mainline"
```

## conf/machine/qemuriscv64_v.conf
```bitbake
#@TYPE: Machine
#@NAME: generic riscv64 machine with V-ext
#@DESCRIPTION: Machine configuration for running a generic riscv64v

require conf/machine/include/riscv/qemuriscv.inc

XVISOR_PLAT = "riscv/virt64"

EXTRA_IMAGEDEPENDS += "u-boot"
UBOOT_MACHINE = "qemu-riscv64_smode_defconfig"
UBOOT_ELF = "u-boot"

# qemuboot options
QB_SYSTEM_NAME = "qemu-system-riscv64"
QB_CPU = "-cpu rv64,x-v=true,vlen=256,elen=64,vext_spec=v1.0"
QB_SMP = "-smp 4"

KMACHINE_qemuriscv64_v = "qemuriscv64"
```

## conf/machine/unmatched.conf
```bitbake
#@TYPE: Machine
#@NAME: unmatched
#@SOC: Freedom U740
#@DESCRIPTION: Machine configuration for the Unmatched development board

DEFAULTTUNE ?= "sifive-7-series"
require conf/machine/include/riscv/tune-sifive.inc

MACHINE_FEATURES = "screen keyboard ext2 ext3 serial alsa pci usbhost vfat"

KERNEL_IMAGETYPE = "Image.gz"

PREFERRED_PROVIDER_virtual/kernel ?= "linux-mainline"
PREFERRED_PROVIDER_virtual/bootloader ?= "u-boot"

EXTRA_IMAGEDEPENDS += "opensbi"
RISCV_SBI_PLAT = "generic"

SERIAL_CONSOLES = "115200;ttySIF0"

MACHINE_EXTRA_RRECOMMENDS += " kernel-modules"

IMAGE_FSTYPES ?= "ext4.xz tar.xz wic.bmap wic.xz"

KERNEL_DEVICETREE ?= "sifive/hifive-unmatched-a00.dtb"

## Do not update fstab file when using wic images
#WIC_CREATE_EXTRA_ARGS ?= "--no-fstab-update"

EXTRA_IMAGEDEPENDS += "u-boot"
UBOOT_MACHINE = "sifive_unmatched_defconfig"

# U-Boot SPL
SPL_BINARY ?= "spl/u-boot-spl.bin"

# U-Boot ITB (FIT image with U-Boot S-mode, OpenSBI FW_DYNAMIC, DTB [from
# U-Boot source code tree])
UBOOT_SUFFIX ?= "itb"

## wic default support
WKS_FILE_DEPENDS ?= " \
    opensbi \
    e2fsprogs-native \
    bmap-tools-native \
"

IMAGE_BOOT_FILES ?= " \
    Image.gz-initramfs-unmatched.bin \
    hifive-unmatched-a00.dtb \
"

WKS_FILE ?= "unmatched-spl-opensbi.wks"
```
